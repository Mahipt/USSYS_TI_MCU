/**
 * These arguments were used when this file was generated. They will be automatically applied on subsequent loads
 * via the GUI or CLI. Run CLI with '--help' for additional information on how to override these arguments.
 * @cliArgs --device "MSPM0L222X" --part "Default" --package "LQFP-80(PNA)" --product "mspm0_sdk@2.05.00.05"
 * @v2CliArgs --device "MSPM0L2228" --package "LQFP-80(PNA)" --product "mspm0_sdk@2.05.00.05"
 * @versions {"tool":"1.24.1+4189"}
 */

/**
 * Import the modules used in this configuration.
 */
const ProjectConfig = scripting.addModule("/ti/project_config/ProjectConfig");

/**
 * Write custom configuration values to the imported modules.
 */
ProjectConfig.genLibDrivers = true;
